# MIMXRT685S_cm33 register map
Vendor: nxp.com; File version: 1.0
MIMXRT685SFAWBR,MIMXRT685SFFOB,MIMXRT685SFVKB
CPU: CM33 r2p0, little endian, MPU, FPU, VTOR, 3 interrupt priority bits
Registers are 32-bit, read-write, reset 0x0 unless marked. A register's access mark holds for its fields unless they carry their own. Offsets are from the block's base; lines under a group give offsets from that group; [hi:lo] are bit positions; {n}, {i} and the like mark numbered series; 'fields as' and 'values as' point back to an identical list; <NAME> marks a mode.

## Memory map
0x40000000 RSTCTL0 size 0x7C — reset ccontroller 0
0x40001000 CLKCTL0 size 0x768 — clock ccontroller 0
0x40002000 SYSCTL0 size 0xFD4 — system controller 0
0x40004000 IOPCTL size 0x408 — LPC-Next0 IO pad controller
0x40006000 PUF size 0x25C — PUF Controller
0x4000E000 WWDT0 size 0x1C — LPC_Next0 Windowed Watchdog Timer (WWDT)
0x4000F000 UTICK0 size 0x20 — LPC-Next0 Micro-tick Timer (UTICK)
0x40020000 RSTCTL1 size 0x7C — reset ccontroller 1
0x40021000 CLKCTL1 size 0x7C8 — clock ccontroller 1
0x40022000 SYSCTL1 size 0x204 — system ccontroller 1
0x40025000 PINT size 0x34 — LPC-Next0 Pin interrupt and pattern match (PINT)
0x40026000 INPUTMUX size 0x7B4 — LPC_Next0 Peripheral Input Multiplexers Controller
0x40028000 CTIMER0 size 0x88 — LPC-Next0 Standard async counter/timer
0x40029000 CTIMER1 size 0x88 — LPC-Next0 Standard async counter/timer
0x4002A000 CTIMER2 size 0x88 — LPC-Next0 Standard async counter/timer
0x4002B000 CTIMER3 size 0x88 — LPC-Next0 Standard async counter/timer
0x4002C000 CTIMER4 size 0x88 — LPC-Next0 Standard async counter/timer
0x4002D000 MRT0 size 0xFC — LPC-Next0 Multi-Rate Timer (MRT)
0x4002E000 WWDT1 size 0x1C — LPC_Next0 Windowed Watchdog Timer (WWDT)
0x4002F000 FREQME size 0x4 — LPC_Next0 Frequency Measurement (FREQME)
0x40030000 RTC size 0x60 — LPC-Next0 Real-Time Clock (RTC)
0x40033000 CACHE64 size 0x810
0x40033000 CACHE64_POLSEL size 0x20
0x40036000 I3C size 0x1000
0x40100000 GPIO size 0x27A0 — LPC-Next0 General Purpose I/O (GPIO)
0x40104000 DMA0 size 0x60C — LPC-Next0 DMA controller
0x40105000 DMA1 size 0x60C — LPC-Next0 DMA controller
0x40106000 FLEXCOMM0 size 0x1000 — LPC-Next0 Flexcomm serial communication
0x40106000 I2C0 size 0x1000 — LPC-Next0 I2C-bus interfaces
0x40106000 I2S0 size 0x1000 — LPC-Next0 I2S interface
0x40106000 SPI0 size 0x1000 — LPC_Next0 Serial Peripheral Interfaces (SPI)
0x40106000 USART0 size 0x1000 — LPC_Next0 USARTs
0x40107000 FLEXCOMM1 size 0x1000 — LPC-Next0 Flexcomm serial communication
0x40107000 I2C1 size 0x1000 — LPC-Next0 I2C-bus interfaces
0x40107000 I2S1 size 0x1000 — LPC-Next0 I2S interface
0x40107000 SPI1 size 0x1000 — LPC_Next0 Serial Peripheral Interfaces (SPI)
0x40107000 USART1 size 0x1000 — LPC_Next0 USARTs
0x40108000 FLEXCOMM2 size 0x1000 — LPC-Next0 Flexcomm serial communication
0x40108000 I2C2 size 0x1000 — LPC-Next0 I2C-bus interfaces
0x40108000 I2S2 size 0x1000 — LPC-Next0 I2S interface
0x40108000 SPI2 size 0x1000 — LPC_Next0 Serial Peripheral Interfaces (SPI)
0x40108000 USART2 size 0x1000 — LPC_Next0 USARTs
0x40109000 FLEXCOMM3 size 0x1000 — LPC-Next0 Flexcomm serial communication
0x40109000 I2C3 size 0x1000 — LPC-Next0 I2C-bus interfaces
0x40109000 I2S3 size 0x1000 — LPC-Next0 I2S interface
0x40109000 SPI3 size 0x1000 — LPC_Next0 Serial Peripheral Interfaces (SPI)
0x40109000 USART3 size 0x1000 — LPC_Next0 USARTs
0x40110000 MUA size 0x68 — LPC-Next0 MUA
0x40112000 SEMA42 size 0x44 — LPC-Next0 SEMA
0x40113000 OSTIMER0 size 0x20 — LPC_Next0 Synchronous OS/Event timer with Wakeup Timer
0x40120000 CRC_ENGINE size 0xC — LPC_Next0 CRC engine
0x40121000 DMIC0 size 0xF9C — LPC_Next0 DMIC Subsystem (DMIC))
0x40122000 FLEXCOMM4 size 0x1000 — LPC-Next0 Flexcomm serial communication
0x40122000 I2C4 size 0x1000 — LPC-Next0 I2C-bus interfaces
0x40122000 I2S4 size 0x1000 — LPC-Next0 I2S interface
0x40122000 SPI4 size 0x1000 — LPC_Next0 Serial Peripheral Interfaces (SPI)
0x40122000 USART4 size 0x1000 — LPC_Next0 USARTs
0x40123000 FLEXCOMM5 size 0x1000 — LPC-Next0 Flexcomm serial communication
0x40123000 I2C5 size 0x1000 — LPC-Next0 I2C-bus interfaces
0x40123000 I2S5 size 0x1000 — LPC-Next0 I2S interface
0x40123000 SPI5 size 0x1000 — LPC_Next0 Serial Peripheral Interfaces (SPI)
0x40123000 USART5 size 0x1000 — LPC_Next0 USARTs
0x40124000 FLEXCOMM6 size 0x1000 — LPC-Next0 Flexcomm serial communication
0x40124000 I2C6 size 0x1000 — LPC-Next0 I2C-bus interfaces
0x40124000 I2S6 size 0x1000 — LPC-Next0 I2S interface
0x40124000 SPI6 size 0x1000 — LPC_Next0 Serial Peripheral Interfaces (SPI)
0x40124000 USART6 size 0x1000 — LPC_Next0 USARTs
0x40125000 FLEXCOMM7 size 0x1000 — LPC-Next0 Flexcomm serial communication
0x40125000 I2C7 size 0x1000 — LPC-Next0 I2C-bus interfaces
0x40125000 I2S7 size 0x1000 — LPC-Next0 I2S interface
0x40125000 SPI7 size 0x1000 — LPC_Next0 Serial Peripheral Interfaces (SPI)
0x40125000 USART7 size 0x1000 — LPC_Next0 USARTs
0x40126000 FLEXCOMM14 size 0x1000 — LPC-Next0 Flexcomm serial communication
0x40126000 SPI14 size 0x1000 — LPC_Next0 Serial Peripheral Interfaces (SPI)
0x40127000 FLEXCOMM15 size 0x1000 — LPC-Next0 Flexcomm serial communication
0x40127000 I2C15 size 0x1000 — LPC-Next0 I2C-bus interfaces
0x40130000 OCOTP size 0x830 — LPC-Next0 OTP controller
0x40134000 FLEXSPI size 0x400
0x40134000 OTFAD size 0xDE0
0x40135000 PMC size 0x34 — LPC-Next0 Power Management Controller
0x40136000 USDHC0 size 0xD0 — uSDHC
0x40137000 USDHC1 size 0xD0 — uSDHC
0x40138000 TRNG size 0xF8 — LPC-Next0 RNG
0x40139000 CMP size 0x1C
0x4013A000 ADC0 size 0x304 — ADC
0x4013B000 USBPHY size 0x140 — Universal System Bus Physical Layer
0x4013B800 USBHSDCD size 0x1C — USBDCD
0x40144000 USBHSD size 0x38 — LPC54S60x/LPC5460x USB1 High-speed Device Controller
0x40145000 USBHSH size 0x54 — LPC-Next0 USB1 High-speed Host Controller
0x40146000 SCT0 size 0x550 — LPC84x SCTimer/PWM (SCT)
0x40148000 AHB_SECURE_CTRL size 0x1000 — LPC_Next0 AHB secure controller
0x40150000 POWERQUAD size 0x260 — LPC-Next0 Digital Signal Co-Processing companion to a Cortex-M v8M CPU core
0x40151000 CASPER size 0x84 — LPC-Next0 CASPER
0x40154000 SECGPIO size 0x27A0 — LPC-Next0 General Purpose I/O (GPIO)
0x40158000 HASHCRYPT size 0xDC — LPC-Next0 Hash-Crypt peripheral
0xE000E000 SCnSCB size 0x10 — System Control not in System Control Block
0xE000E100 NVIC size 0xE04 — Nested Vectored Interrupt Controller
0xE000ED00 SCB size 0x90 — System Control Block
0xE000ED90 MPU size 0x40 — Memory Protection Unit
0xE000EDD0 SAU size 0xEC — Security Attribution Unit

## Interrupts
0 WDT0 (WWDT0)
1 DMA0
2 GPIO_INTA (GPIO)
3 GPIO_INTB (GPIO)
4 PIN_INT0 (PINT)
5 PIN_INT1 (PINT)
6 PIN_INT2 (PINT)
7 PIN_INT3 (PINT)
8 UTICK0
9 MRT0
10 CTIMER0
11 CTIMER1
12 SCT0
13 CTIMER3
14 FLEXCOMM0 (FLEXCOMM0, I2C0, I2S0, SPI0, USART0)
15 FLEXCOMM1 (FLEXCOMM1, I2C1, I2S1, SPI1, USART1)
16 FLEXCOMM2 (FLEXCOMM2, I2C2, I2S2, SPI2, USART2)
17 FLEXCOMM3 (FLEXCOMM3, I2C3, I2S3, SPI3, USART3)
18 FLEXCOMM4 (FLEXCOMM4, I2C4, I2S4, SPI4, USART4)
19 FLEXCOMM5 (FLEXCOMM5, I2C5, I2S5, SPI5, USART5)
20 FLEXCOMM14 (FLEXCOMM14, SPI14)
21 FLEXCOMM15 (FLEXCOMM15, I2C15)
22 ADC0
24 ACMP (CMP)
25 DMIC0
27 HYPERVISOR (AHB_SECURE_CTRL)
28 SECUREVIOLATION (AHB_SECURE_CTRL)
29 HWVAD0 (DMIC0)
31 RNG (TRNG)
32 RTC
33 DSPWAKE (PMC)
34 MU_A (MUA)
35 PIN_INT4 (PINT)
36 PIN_INT5 (PINT)
37 PIN_INT6 (PINT)
38 PIN_INT7 (PINT)
39 CTIMER2
40 CTIMER4
41 OS_EVENT (OSTIMER0)
42 FLEXSPI
43 FLEXCOMM6 (FLEXCOMM6, I2C6, I2S6, SPI6, USART6)
44 FLEXCOMM7 (FLEXCOMM7, I2C7, I2S7, SPI7, USART7)
45 USDHC0
46 USDHC1
47 SGPIO_INTA (SECGPIO)
48 SGPIO_INTB (SECGPIO)
49 I3C0 (I3C)
50 USB (USBHSD, USBHSH)
51 USB_WAKEUP (USBHSH)
52 WDT1 (WWDT1)
53 USBPHY_DCD (USBHSDCD)
54 DMA1
55 PUF
56 POWERQUAD
57 CASPER
58 PMC_PMIC (PMC)
59 HASHCRYPT

## Licence text in the file
Copyright 2016-2023 NXP SPDX-License-Identifier: BSD-3-Clause
